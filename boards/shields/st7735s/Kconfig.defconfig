## boards/shields/st7735s/Kconfig.defconfig
```kconfig
# Copyright (c) 2020 Kim Bøndergaard <kim@fam-boendergaard.dk>
# SPDX-License-Identifier: Apache-2.0

if SHIELD_ST7735S_128x160

if DISPLAY

if LVGL

config LV_Z_BITS_PER_PIXEL
	default 16

endif # LVGL

endif # DISPLAY

endif # SHIELD_ST7735S_128x160
```

## boards/shields/st7735s/Kconfig.shield
```kconfig
# Copyright (c) 2020 Kim Bøndergaard <kim@fam-boendergaard.dk>
# SPDX-License-Identifier: Apache-2.0

config SHIELD_ST7735S_128x160
	def_bool $(shields_list_contains,st7735s_128x160)
```
