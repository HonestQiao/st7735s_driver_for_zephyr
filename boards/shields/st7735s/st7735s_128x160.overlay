/*
 * Copyright (c) 2020, Kim Bøndergaard, <kim@fam-boendergaard.dk>
 *
 * SPDX-License-Identifier: Apache-2.0
 */

/ {
	chosen {
		zephyr,display = &st7735s_st7735s_128x160;
	};
};

&arduino_spi {
	status = "okay";
	cs-gpios = <&arduino_header 16 GPIO_ACTIVE_LOW>;	/* D10 */

	st7735s_st7735s_128x160: st7735s@0 {
		compatible = "sitronix,st7735s";
		spi-max-frequency = <20000000>;
		reg = <0>;
		lcd-logic-power-gpios = <&arduino_header 13 GPIO_ACTIVE_HIGH>;	/* D7 */
		lcd-backlight-power-gpios = <&arduino_header 10 GPIO_ACTIVE_HIGH>;	/* D4 */
		cmd-data-gpios = <&arduino_header 15 GPIO_ACTIVE_LOW>;	/* D9 */
		reset-gpios = <&arduino_header 14 GPIO_ACTIVE_LOW>;	/* D8 */
		width = <128>;
		height = <160>;
		x-offset = <0>;
		y-offset = <0>;
		madctl = <0xc0>;
		colmod = <0x55>;
		caset = [00 00 00 4F];
		raset = [00 00 00 9F];
		vmctr1 = <0x0e>;
		invctr = <0x07>;
		pwctr1 = [a2 02 84];
		pwctr2 = [c5];
		pwctr3 = [0a 00];
		pwctr4 = [8a 2a];
		pwctr5 = [8a ee];
		frmctr1 = [01 2c 2d];
		frmctr2 = [01 2c 2d];
		frmctr3 = [01 2c 2d 01 2c 2d];
		gamctrp1 = [02 1c 07 12 37 32 29 2d 29 25 2b 39 00 01 03 10];
		gamctrn1 = [03 1d 07 06 2e 2c 29 2d 2e 2e 37 3f 00 00 02 10];
	};
};
